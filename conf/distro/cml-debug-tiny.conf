## conf/distro/cml-debug-tiny.conf
```bitbake
require conf/distro/cml-base.conf

#gdb segfaults when building with musl in thud
TCLIBC = "glibc"

INITRAMFS_MAXSIZE = "100000000"


INHIBIT_SYSROOT_STRIP = "1"
INHIBIT_PACKAGE_DEBUG_SPLIT = "1"
INHIBIT_PACKAGE_STRIP = "1"

#CFLAGS:prepend = " -g -Og "
#TARGET_CFLAGS:prepend = " -g -Og"

DEBUG_BUILD = "1"
```

## conf/distro/cml-debug.conf
```bitbake
require conf/distro/poky.conf

#gdb segfaults when building with musl in thud
#TCLIBC = "glibc"

INITRAMFS_MAXSIZE = "100000000"

INHIBIT_PACKAGE_DEBUG_SPLIT = "1"
INHIBIT_PACKAGE_STRIP = "1"


#CFLAGS:prepend = " -g -Og "
#TARGET_CFLAGS:prepend = " -g -Og "

DEBUG_BUILD = "1"
```

## conf/layer.conf
```bitbake
BBPATH := "${BBPATH}:${LAYERDIR}" 

BBFILES := "${BBFILES} ${LAYERDIR}/recipes-*/*/*.bb \ 
           ${LAYERDIR}/recipes-*/*/*.bbappend \
	   ${LAYERDIR}/images/*.bb*"


BBFILE_COLLECTIONS += "tmedebug-layer"
BBFILE_PATTERN_tmedebug-layer := "^${LAYERDIR}/"
BBFILE_PRIORITY_tmedebug-layer := "10"

LAYERDEPENDS_tmedebug-layer = "virtualization-layer"

LAYERSERIES_COMPAT_tmedebug-layer += "thud zeus dunfell kirkstone"
```
